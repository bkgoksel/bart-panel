#pragma once
// Web portal: template editor, live data for its preview, and firmware upload.
// Also Arduino OTA so arduino-cli can upload over the network.

#include <WebServer.h>
#include <LittleFS.h>
#include <Update.h>
#include <ArduinoOTA.h>
#include <ESPmDNS.h>
#include "state.h"
#include "portal_html.h"  // PORTAL_HTML, DEFAULT_TEMPLATE; generated by tools/embed_web.ps1

#define TEMPLATE_PATH "/template.json"

static WebServer server(80);
static bool uploadAuthorized = false;

static bool checkAuth() {
  if (!PORTAL_PASS[0] || server.authenticate("admin", PORTAL_PASS)) return true;
  server.requestAuthentication();
  return false;
}

// Makes t the active template and points the fetch task at its lanes.
static void applyTemplate(const Template &t, const String &json) {
  tpl = t;
  tplJson = json;
  display->setBrightness8(tpl.brightness);

  portENTER_CRITICAL(&dataLock);
  strlcpy(fetchCfg.station, tpl.station, sizeof(fetchCfg.station));
  memcpy(fetchCfg.lanes, tpl.lanes, sizeof(fetchCfg.lanes));
  fetchCfg.laneCount = tpl.laneCount;
  memset(lanes, 0, sizeof(lanes));  // lane order may have changed; refetch below
  portEXIT_CRITICAL(&dataLock);
  if (fetchTaskHandle) xTaskNotifyGive(fetchTaskHandle);
}

// Loads the saved template, falling back to the built-in default.
static void loadTemplate() {
  static Template t;
  String json;
  File f = LittleFS.open(TEMPLATE_PATH, "r");
  if (f) {
    json = f.readString();
    f.close();
    String err = parseTemplate(json.c_str(), t);
    if (err.isEmpty()) {
      applyTemplate(t, json);
      return;
    }
    Serial.printf("Saved template invalid (%s), using default\n", err.c_str());
  }
  json = DEFAULT_TEMPLATE;
  parseTemplate(json.c_str(), t);
  applyTemplate(t, json);
}

static void handlePostTemplate() {
  if (!checkAuth()) return;
  static Template t;
  String json = server.arg("plain");
  String err = parseTemplate(json.c_str(), t);
  if (!err.isEmpty()) {
    server.send(400, "text/plain", err);
    return;
  }
  File f = LittleFS.open(TEMPLATE_PATH, "w");
  if (!f || !f.print(json)) {
    server.send(500, "text/plain", "could not save template");
    return;
  }
  f.close();
  applyTemplate(t, json);
  server.send(200, "text/plain", "applied");
}

// Current trains per lane, for the portal's preview.
static void handleData() {
  Lane snap[MAX_LANES];
  uint32_t at;
  bool ok;
  portENTER_CRITICAL(&dataLock);
  memcpy(snap, lanes, sizeof(snap));
  at = fetchedAt;
  ok = haveData;
  portEXIT_CRITICAL(&dataLock);

  JsonDocument doc;
  doc["ok"] = ok;
  doc["age"] = millis() - at;
  JsonArray out = doc["lanes"].to<JsonArray>();
  for (int i = 0; i < tpl.laneCount; i++) {
    JsonObject l = out.add<JsonObject>();
    l["id"] = tpl.lanes[i].id;
    JsonArray trains = l["trains"].to<JsonArray>();
    for (int j = 0; j < snap[i].count; j++) {
      JsonObject tr = trains.add<JsonObject>();
      tr["m"] = snap[i].trains[j].minutes;
      tr["cars"] = snap[i].trains[j].cars;
      char hex[8];
      snprintf(hex, sizeof(hex), "#%06lx", (unsigned long)snap[i].trains[j].rgb);
      tr["rgb"] = hex;
    }
  }
  String body;
  serializeJson(doc, body);
  server.send(200, "application/json", body);
}

static void handleUpdateChunk() {
  HTTPUpload &up = server.upload();
  if (up.status == UPLOAD_FILE_START) {
    uploadAuthorized = !PORTAL_PASS[0] || server.authenticate("admin", PORTAL_PASS);
    if (!uploadAuthorized) return;
    Serial.printf("Firmware upload: %s\n", up.filename.c_str());
    Update.begin(UPDATE_SIZE_UNKNOWN);
  } else if (!uploadAuthorized) {
    return;
  } else if (up.status == UPLOAD_FILE_WRITE) {
    Update.write(up.buf, up.currentSize);
  } else if (up.status == UPLOAD_FILE_END) {
    Update.end(true);
  } else if (up.status == UPLOAD_FILE_ABORTED) {
    Update.abort();
  }
}

static void handleUpdateDone() {
  if (!uploadAuthorized) {
    server.requestAuthentication();
    return;
  }
  if (Update.hasError()) {
    server.send(500, "text/plain", String("update failed: ") + Update.errorString());
    return;
  }
  server.send(200, "text/plain", "updated, restarting");
  delay(500);
  ESP.restart();
}

static void setupPortal() {
  server.on("/", HTTP_GET, [] { server.send_P(200, "text/html", PORTAL_HTML); });
  server.on("/template", HTTP_GET, [] { server.send(200, "application/json", tplJson); });
  server.on("/template", HTTP_POST, handlePostTemplate);
  server.on("/template/default", HTTP_GET,
            [] { server.send_P(200, "application/json", DEFAULT_TEMPLATE); });
  server.on("/data", HTTP_GET, handleData);
  server.on("/update", HTTP_POST, handleUpdateDone, handleUpdateChunk);
  server.begin();
}

// Called once Wi-Fi is up.
static void startNetworkServices() {
  ArduinoOTA.setHostname(HOSTNAME);
  if (PORTAL_PASS[0]) ArduinoOTA.setPassword(PORTAL_PASS);
  ArduinoOTA.begin();  // also starts mDNS as HOSTNAME.local
  MDNS.addService("http", "tcp", 80);
  Serial.printf("Portal: http://%s/ or http://%s.local/\n", WiFi.localIP().toString().c_str(),
                HOSTNAME);
}
